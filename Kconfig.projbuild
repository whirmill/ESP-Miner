## Kconfig.projbuild
```kconfig
menu "ESP-Miner"

    config ESP_MINER_HEADLESS
        bool "Headless build (no display UI, no AxeOS static files)"
        default n
        help
            Build a minimal firmware intended for no-PSRAM targets.

            - Skips display/LVGL/screen/input initialization.
            - Skips building/serving AxeOS static files (www).
            - Keeps REST API and WebSocket endpoints for external control apps.

endmenu
```

## main/Kconfig.projbuild
```kconfig
menu "ESP-Miner Build Options"

    config ESP_MINER_HEADLESS
        bool "Headless build (no display UI, no AxeOS static files)"
        default n
        help
            Build a minimal firmware intended for no-PSRAM targets.

            - Skips display/LVGL/screen/input initialization.
            - Skips building/serving AxeOS static files (www).
            - Keeps REST API and WebSocket endpoints for external control apps.

    config ESP_MINER_DISABLE_WEB_UI
        bool "Disable AxeOS web UI (keep display UI)"
        default n
        help
            Disable building and serving the AxeOS static web dashboard.

            - Keeps display/LVGL/screen/input initialization.
            - Keeps REST API and WebSocket endpoints for external control apps.
            - Generates a minimal 'www' SPIFFS image so flashing layout stays unchanged.

    config ESP_MINER_LIGHTWEIGHT_RAM
        bool "Lightweight RAM mode (reduce historical buffers)"
        default n
        help
            Reduce runtime RAM footprint for no-PSRAM targets.

            Currently this limits in-RAM historical metric buffers used for
            graphing (e.g. /api/system/statistics history).

    config ESP_MINER_DISABLE_CONFIG_AP
        bool "Disable Wi-Fi config AP/captive portal (external control only)"
        default n
        help
            Disable the built-in Wi-Fi configuration access point (SoftAP) and
            captive-portal DNS redirect used for local setup.

            Intended for setups where:
            - Wi-Fi credentials are provisioned via flashed config (CSV) and/or
              an external controller app using REST/WebSocket APIs.
            - The device should run in STA-only mode to reduce RAM usage.

            Effects:
            - No SoftAP at boot.
            - No captive DNS server.
            - Long-press button will not toggle SoftAP.

    config ESP_MINER_DISABLE_BAP
        bool "Disable BAP subsystem (UART accessory protocol)"
        default n
        help
            Disable the Bitaxe Accessory Protocol (BAP) subsystem.

            This saves RAM by skipping BAP queues, mutexes, and background tasks.
            Intended for lightweight, external-control builds that rely on
            REST/WebSocket APIs instead of UART accessories.

endmenu

menu "Bitaxe Configuration"

    menu "GPIO Pin Configuration"

        config GPIO_BUTTON_BOOT
            int "Boot button GPIO pin"
            default 0
            help
                GPIO pin connected to the BOOT button.

        config GPIO_ASIC_RESET
            int "ASIC reset GPIO pin"
            default 1
            help
                GPIO pin for ASIC_RESET (RST_N), reset input to ASIC.

        config GPIO_ASIC_ENABLE
            int "ASIC enable GPIO pin"
            default 10
            help
                GPIO pin for ASIC_ENABLE (POWER_EN), enable for core power supply.

        config GPIO_PLUG_SENSE
            int "Barrel plug sense GPIO pin"
            default 12
            help
                GPIO pin for DC barrel (PLUG_SENSE), sense pin of DC power jack socket.

        config GPIO_I2C_SDA
            int "I2C SDA Pin"
            default 47
            help
                GPIO pin for I2C clock line (SDA).
            
        config GPIO_I2C_SCL
            int "I2C SCL Pin"
            default 48
            help
                GPIO pin for I2C clock line (SCL).
        config GPIO_BAP_RX
            int "I2C BAP Pin"
            default 40
            help
                GPIO pin for BAP receiving line.
        config GPIO_BAP_TX
            int "I2C BAP Pin"
            default 39
            help
                GPIO pin for BAP transmitting line.
            
    endmenu
    
    config ASIC_VOLTAGE
        int "ASIC Core Voltage (mV)"
        range 1000 1800
        default 1400
        help
            The core voltage to set the ASIC to. 1200 for BM1366 or 1400 for BM1397 is typical.

    config ASIC_FREQUENCY
        int "ASIC Hash Frequency (MHz)"
        range 50 800
        default 250
        help
            The BM1397 hash frequency
endmenu

menu "Stratum Configuration"

    config STRATUM_URL
        string "Stratum Address"
        default "public-pool.io"
        help
            The example will connect to this Stratum pool address.

    config STRATUM_PORT
        int "Stratum Port"
        range 0 65535
        default 21496
        help
            The stratum server port to connect to.
    
    choice
        prompt "Stratum TLS mode"
        default STRATUM_TLS_DISABLED
        help
            Select how TLS is used for stratum connections.

        config STRATUM_TLS_DISABLED
            bool "Disabled"

        config STRATUM_TLS_BUNDLED
            bool "Enabled (bundled CA certificate)"

        config STRATUM_TLS_CUSTOM
            bool "Enabled (user-provided/custom CA certificate)"
    endchoice

    config STRATUM_TLS
        int
        default 0 if STRATUM_TLS_DISABLED
        default 1 if STRATUM_TLS_BUNDLED
        default 2 if STRATUM_TLS_CUSTOM
    
    config STRATUM_CERT
        string "Stratum Certificate"
        default "x"
        help
            The certificate to use with the stratum connection.

    config EXTRANONCE_SUBSCRIBE
        bool "Pool extranonce subscribe"
        default n
        help
            Enable stratum extranonce subscribe.

    config FALLBACK_STRATUM_URL
        string "Fallback Stratum Address"
        default "solo.ckpool.org"
        help
            The example will connect to this Stratum pool address if the primary fails.

    config FALLBACK_STRATUM_PORT
        int "Fallback Stratum Port"
        range 0 65535
        default 3333
        help
            The stratum server port to connect to if the primary fails.
    
    choice
        prompt "Fallback Stratum TLS mode"
        default FALLBACK_STRATUM_TLS_DISABLED
        help
            Select how TLS is used for stratum connections.

        config FALLBACK_STRATUM_TLS_DISABLED
            bool "Disabled"

        config FALLBACK_STRATUM_TLS_BUNDLED
            bool "Enabled (bundled CA certificate)"

        config FALLBACK_STRATUM_TLS_CUSTOM
            bool "Enabled (user-provided/custom CA certificate)"
    endchoice

    config FALLBACK_STRATUM_TLS
        int
        default 0 if FALLBACK_STRATUM_TLS_DISABLED
        default 1 if FALLBACK_STRATUM_TLS_BUNDLED
        default 2 if FALLBACK_STRATUM_TLS_CUSTOM
    
    config FALLBACK_STRATUM_CERT
        string "Fallback Stratum Certificate"
        default "x"
        help
            The certificate to use with the stratum connection if the primary fails.

    config FALLBACK_EXTRANONCE_SUBSCRIBE
        bool "Fallback pool extranonce subscribe"
        default n
        help
            Enable fallback pool extranonce subscribe.

    config STRATUM_USER
        string "Stratum username"
        default "replace-this-with-your-btc-address.bitaxe"
        help
            Stratum user to use with pool

    config STRATUM_PW
        string "Stratum password"
        default "x"
        help
            Stratum password to use with pool

    config FALLBACK_STRATUM_USER
        string "Fallback Stratum username"
        default "replace-this-with-your-btc-address.bitaxe"
        help
            Fallback Stratum user to use with pool

    config FALLBACK_STRATUM_PW
        string "Fallback Stratum password"
        default "x"
        help
            Fallback Stratum password to use with pool

    config STRATUM_DIFFICULTY
        int "Stratum default difficulty"
        range 0 4294967296
        default 1000
        help
            A starting difficulty to use with the pool.

    config FALLBACK_STRATUM_DIFFICULTY
        int "Fallback stratum default difficulty"
        range 0 4294967296
        default 1000
        help
            A starting difficulty to use with the fallback pool.

endmenu
```
